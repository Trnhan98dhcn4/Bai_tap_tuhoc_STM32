# file: Bai_Tap_GPIO.ioc
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Mcu.Family=STM32F4
Mcu.Name=STM32F411V(C-E)Tx
Mcu.Package=LQFP100
NVIC.PriorityGroup=NVIC_PRIORITYGROUP_4
PA13.Mode=Serial_Wire
PA13.Signal=SYS_JTMS-SWDIO
PA14.Mode=Serial_Wire
PA14.Signal=SYS_JTCK-SWCLK
ProjectManager.HeapSize=0x200
ProjectManager.StackSize=0x400
ProjectManager.TargetToolchain=STM32CubeIDE
RCC.AHBFreq_Value=16000000
RCC.APB1Freq_Value=16000000
RCC.APB2Freq_Value=16000000
RCC.CortexFreq_Value=16000000
RCC.HSE_VALUE=25000000
RCC.HSI_VALUE=16000000
RCC.LSE_VALUE=32768
RCC.SYSCLKFreq_VALUE=16000000
RCC.VCOOutputFreq_Value=192000000
board=custom

// file: Core/Src/main.c
/* USER CODE BEGIN Header */
/**
  ******************************************************************************
  * @file           : main.c
  * @brief          : Main program body
  ******************************************************************************
  * @attention
  *
  * Copyright (c) 2022 STMicroelectronics.
  * All rights reserved.
  *
  * This software is licensed under terms that can be found in the LICENSE file
  * in the root directory of this software component.
  * If no LICENSE file comes with this software, it is provided AS-IS.
  *
  ******************************************************************************
  */
/* USER CODE END Header */
#include "main.h"

void SystemClock_Config(void);
static void MX_GPIO_Init(void);

/* USER CODE BEGIN 0 */
#define GPIOA_BASE_ADDRESS 0x40020000
#define GPIOD_BASE_ADDRESS 0x40020C00

void GPIO_Init()
{
	__HAL_RCC_GPIOA_CLK_ENABLE();
	__HAL_RCC_GPIOD_CLK_ENABLE();

	//khai bao input
	uint32_t* GPIOA_MODER = (uint32_t*)(GPIOA_BASE_ADDRESS + 0x00); // thanh ghi moder
	uint32_t* GPIOA_PUPDR = (uint32_t*)(GPIOA_BASE_ADDRESS + 0x0C); // khai bao floating / push up / push down

	*GPIOA_MODER &= ~(0b11); // khai bao input
	*GPIOA_PUPDR &= ~(0b11); // 00: No pull-up, pull-down

	//khai bao output
	uint32_t* GPIOD_MODER = (uint32_t*)(GPIOD_BASE_ADDRESS + 0x00);
	uint32_t* GPIO_OTYPER = (uint32_t*)(GPIOD_BASE_ADDRESS + 0x04);

	// khai bao thanh ghi output
	*GPIOD_MODER &= ~(0xFF << 24);
	*GPIOD_MODER |= (0b01 << 24) | (0b01 << 26) | (0b01 << 28) | (0b01 << 30);

	*GPIO_OTYPER &= ~(0xF << 12);

}

typedef enum
{
	LED_1 = 12, LED_2, LED_3, LED_4,
}led_num_t;

typedef enum
{
	LED_OFF, LED_ON
}state_t;

void led_control(led_num_t led_num, state_t state)
{
	uint32_t* GPIOD_ODR = (uint32_t*)(GPIOD_BASE_ADDRESS + 0x14);
	if(state == LED_ON)
	{
		*GPIOD_ODR |=  (0b1 << led_num);
	}
	else
	{
		*GPIOD_ODR &= ~(0b1 << led_num);
	}
}

char get_button()
{
	uint32_t* GPIOA_IDR = (uint32_t*)(GPIOA_BASE_ADDRESS + 0x10);
	return *GPIOA_IDR & 0b1;
}
/* USER CODE END 0 */

int main(void)
{

  /* MCU Configuration--------------------------------------------------------*/

  /* Reset of all peripherals, Initializes the Flash interface and the Systick. */
  HAL_Init();

  /* Configure the system clock */
  SystemClock_Config();

  /* Initialize all configured peripherals */
  MX_GPIO_Init();
  /* USER CODE BEGIN 2 */
  GPIO_Init();
  /* USER CODE END 2 */

  /* Infinite loop */
  while (1)
  {
	  led_control(LED_1 , LED_ON);
	  led_control(LED_2 , LED_ON);
	  led_control(LED_3 , LED_ON);
	  led_control(LED_4 , LED_ON);
	  HAL_Delay(1000);
	  led_control(LED_1 , LED_OFF);
	  led_control(LED_2 , LED_OFF);
	  led_control(LED_3 , LED_OFF);
	  led_control(LED_4 , LED_OFF);
	  HAL_Delay(1000);
  }
}

void SystemClock_Config(void)
{
  RCC_OscInitTypeDef RCC_OscInitStruct = {0};
  RCC_ClkInitTypeDef RCC_ClkInitStruct = {0};

  /** Configure the main internal regulator output voltage
  */
  __HAL_RCC_PWR_CLK_ENABLE();
  __HAL_PWR_VOLTAGESCALING_CONFIG(PWR_REGULATOR_VOLTAGE_SCALE1);

  /** Initializes the RCC Oscillators according to the specified parameters
  * in the RCC_OscInitTypeDef structure.
  */
  RCC_OscInitStruct.OscillatorType = RCC_OSCILLATORTYPE_HSI;
  RCC_OscInitStruct.HSIState = RCC_HSI_ON;
  RCC_OscInitStruct.HSICalibrationValue = RCC_HSICALIBRATION_DEFAULT;
  RCC_OscInitStruct.PLL.PLLState = RCC_PLL_NONE;
  if (HAL_RCC_OscConfig(&RCC_OscInitStruct) != HAL_OK)
  {
    Error_Handler();
  }

  /** Initializes the CPU, AHB and APB buses clocks
  */
  RCC_ClkInitStruct.ClockType = RCC_CLOCKTYPE_HCLK|RCC_CLOCKTYPE_SYSCLK
                              |RCC_CLOCKTYPE_PCLK1|RCC_CLOCKTYPE_PCLK2;
  RCC_ClkInitStruct.SYSCLKSource = RCC_SYSCLKSOURCE_HSI;
  RCC_ClkInitStruct.AHBCLKDivider = RCC_SYSCLK_DIV1;
  RCC_ClkInitStruct.APB1CLKDivider = RCC_HCLK_DIV1;
  RCC_ClkInitStruct.APB2CLKDivider = RCC_HCLK_DIV1;

  if (HAL_RCC_ClockConfig(&RCC_ClkInitStruct, FLASH_LATENCY_0) != HAL_OK)
  {
    Error_Handler();
  }
}

static void MX_GPIO_Init(void)
{

  /* GPIO Ports Clock Enable */
  __HAL_RCC_GPIOA_CLK_ENABLE();

}

void Error_Handler(void)
{
  __disable_irq();
  while (1)
  {
  }
}
